## Kconfig.mkd
```kconfig
#Kconfig作用

分布在各目录下的Kconfig构成了一个分布式的内核配置数据库，每个Kconfig分别描述了所属目录源文件相关的内核配置菜单。在内核配置make menuconfig(或xconfig等)时，从Kconfig中读出配置菜单，用户配置完后保存到.config(在顶层目录下生成)中。在内核编译时，主Makefile调用这个.config，就知道了用户对内核的配置情况。  

#Kconfig语法

**每个菜单项都有一个关键字标识，最常见的就是config。**

	config symbol

	options
	<!--[if !supportLineBreakNewLine]-->
	<!--[endif]-->

symbol就是新的菜单项，options是在这个新的菜单项下的属性和选项  

----

##Options
其中options部分有：

1. 类型定义

    每个config菜单项都要有类型定义，bool：布尔类型， tristate三态：内建、模块、移除， string：字符串， hex：十六进制， integer：整型  

1. 依赖型定义depends on或requires

    指此菜单的出现是否依赖于另一个定义

1. 帮助性定义

    只是增加帮助用关键字help或---help---


----

##包含
`source "drivers/usb/Kconfig"`
用来包含（或嵌套）新的Kconfig文件，这样便可以使各个目录管理各自的配置内容，使不必把那些配置都写在同一个文件里，方便修改和管理。
```
